## AP_controller/main/Kconfig.projbuild
```kconfig
menu "Wi-Fi CSI Project Configuration"

config WIFI_SSID
    string "Wi-Fi SSID"
    default "TCC_CSI_AP"

config WIFI_PASSWORD
    string "Wi-Fi password"
    default "12345678"

config WIFI_CHANNEL
    int "Wi-Fi channel"
    default 6

config MAX_CLIENTS
    int "Maximum number of connected stations"
    default 1

endmenu
```

## STA_CSI_receiver/main/Kconfig.projbuild
```kconfig
menu "Wi-Fi CSI Project Configuration"

config WIFI_SSID
    string "Wi-Fi SSID"
    default "TCC_CSI_AP"

config WIFI_PASSWORD
    string "Wi-Fi password"
    default "12345678"

endmenu
```
